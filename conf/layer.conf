## conf/layer.conf
```bitbake
# We have a conf and classes directory, add to BBPATH
BBPATH .= ":${LAYERDIR}"

# We have a recipes-* directories, add to BBFILES
BBFILES += "${LAYERDIR}/recipes-*/*/*.bb \
	${LAYERDIR}/recipes-*/*/*.bbappend"

BBFILE_COLLECTIONS += "eukrea-cpuimx51"
BBFILE_PATTERN_eukrea-cpuimx51 = "^${LAYERDIR}/"
BBFILE_PRIORITY_eukrea-cpuimx51 = "6"
```

## conf/machine/eukrea-cpuimx51.conf
```bitbake
#@TYPE: Machine
#@NAME: eukrea-cpuimx51

#@DESCRIPTION: Machine configuration for eukrea-cpuimx51 systems (Freescale i.MX51 based Eukrea CPUIMX51 + baseboard)

PREFERRED_PROVIDER_virtual/xserver ?= "xserver-xorg"
XSERVER = "xserver-xorg \
           xf86-input-tslib \
           xf86-input-keyboard \
           xf86-input-mouse \
           xf86-video-fbdev"

DEFAULTTUNE ?= "cortexa8hf-neon"
include conf/machine/include/tune-cortexa8.inc

SERIAL_CONSOLE ?= "115200 ttymxc0"

ROOT_FLASH_SIZE = "256"
IMAGE_FSTYPES += "ubi tar.bz2"

# NAND
MKUBIFS_ARGS = "-m 2048 -e 129024 -c 8152"
UBINIZE_ARGS = "-m 2048 -p 128KiB -s 512"

PREFERRED_PROVIDER_virtual/bootloader = "barebox"
#PREFERRED_VERSION_barebox = "2012.09.0"
PREFERRED_VERSION_barebox = "2015.11.0"
BAREBOX_MACHINE = "eukrea_cpuimx51"
UBOOT_ENTRYPOINT = "0x90008000"
UBOOT_LOADADDRESS = "0x90008000"

PREFERRED_PROVIDER_virtual/kernel ?= "linux-yocto"
PREFERRED_VERSION_linux-yocto ?= "3.19%"
KERNEL_IMAGETYPE = "uImage"
KERNEL_DEVICETREE = "imx51-eukrea-mbimxsd51-baseboard.dtb"
KERNEL_EXTRA_ARGS += "LOADADDR=${UBOOT_ENTRYPOINT}"

MACHINE_FEATURES = "kernel26 apm alsa ext2 ext3 usbhost usbgadget screen camera can touchscreen bluetooth ppp"

MACHINE_EXTRA_RRECOMMENDS = " kernel-modules kernel-devicetree"

EXTRA_IMAGEDEPENDS += "virtual/bootloader"

GUI_MACHINE_CLASS = "bigscreen"
```
